## Kconfig
```kconfig
menu "eIQ"
    config MCUX_COMPONENT_middleware.eiq.neutron
        bool "Enable neutron"
    config MCUX_PRJSEG_middleware.eiq.neutron
        bool "Stage neutron sources/libs into freestanding"
    rsource "./**/Kconfig"
    rsource "./executorch_build/executorch.Kconfig"
endmenu
```
